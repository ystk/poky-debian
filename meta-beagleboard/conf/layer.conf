## meta-beagleboard/conf/layer.conf
```bitbake
BBPATH := "${BBPATH}:${LAYERDIR}"
BBFILES := " ${BBFILES} \
${LAYERDIR}/recipes-*/*/*.bb \
${LAYERDIR}/recipes-*/*/*.bbappend \
"

BBFILE_COLLECTIONS += "beagleboard"
BBFILE_PATTERN_beagleboard := "^${LAYERDIR}/"
BBFILE_PRIORITY_beagleboard = "6"

# default revision
BEAGLEBOARD_REV ?= "xmc"

MACHINE = "beagleboard-${BEAGLEBOARD_REV}"

# FIXME: just a dummy config
LINUX_CONF ?= "arch/arm/configs/omap2plus_defconfig"

UBOOT_REPO_COMMIT = "u-boot-2011.06"
UBOOT_CHKSUM = " \
file://COPYING;md5=1707d6db1d42237583f50183a5651ecb \
file://README;beginline=1;endline=22;md5=5ba4218ac89af7846802d0348df3fb90 \
"
```

## meta-beagleboard/conf/machine/beagleboard-xmc.conf
```bitbake
#@TYPE: Machine
#@NAME: beagleboard-xmc
#@DESCRIPTION: Machine setting for 'Beagleboard-xM rev.C' (cortex-A8 board)

include conf/machine/include/tune-cortexa8.inc

KERNEL_IMAGETYPE = "uImage"

IMAGE_FSTYPES = "tar.bz2"

# 2.6.37 and later kernels use OMAP_SERIAL, ttyO2
# earlier kernels use ttyS2
SERIAL_CONSOLE = "115200 ttyO2"

EXTRA_IMAGEDEPENDS += "u-boot x-load"

UBOOT_MACHINE = "omap3_beagle_config"
UBOOT_ENTRYPOINT = "0x80008000"
UBOOT_LOADADDRESS = "0x80008000"
```

## meta-cubox/conf/layer.conf
```bitbake
BBPATH := "${BBPATH}:${LAYERDIR}"
BBFILES := " ${BBFILES} \
${LAYERDIR}/recipes-*/*/*.bb \
${LAYERDIR}/recipes-*/*/*.bbappend \
"

BBFILE_COLLECTIONS += "cubox"
BBFILE_PATTERN_cubox := "^${LAYERDIR}/"
BBFILE_PRIORITY_cubox = "6"

MACHINE = "cubox"

PREFERRED_PROVIDER_virtual/kernel = "linux"
PREFERRED_PROVIDER_linux-libc-headers = "linux-libc-headers"
PREFERRED_PROVIDER_linux-libc-headers-nativesdk = "linux-libc-headers-nativesdk"
```

## meta-cubox/conf/machine/cubox.conf
```bitbake
#@TYPE: Machine
#@NAME: cubox
#@DESCRIPTION: Machine settings for CuBox (Marvell Armada 510 ARMv7-A Sheeva PJ4)

require conf/machine/include/tune-armv7a.inc

KERNEL_IMAGETYPE = "uImage"

SERIAL_CONSOLE = "115200 ttyS0"
```

## meta-jta/conf/layer.conf
```bitbake
BBPATH := "${BBPATH}:${LAYERDIR}"
BBFILES := " ${BBFILES} \
${LAYERDIR}/recipes-*/*/*.bb \
${LAYERDIR}/recipes-*/*/*.bbappend \
"

BBFILE_COLLECTIONS += "jta"
BBFILE_PATTERN_jta := "^${LAYERDIR}/"
BBFILE_PRIORITY_jta = "10"
```

## meta-minnow/conf/layer.conf
```bitbake
BBPATH := "${BBPATH}:${LAYERDIR}"
BBFILES := " ${BBFILES} \
${LAYERDIR}/recipes-*/*/*.bb \
${LAYERDIR}/recipes-*/*/*.bbappend \
"

BBFILE_COLLECTIONS += "minnow"
BBFILE_PATTERN_minnow := "^${LAYERDIR}/"
BBFILE_PRIORITY_minnow = "6"

RELEASE_VERSION = "${DEBIAN_SQUEEZE_VERSION}-minnow-0.1"

MACHINE = "minnow"

LINUX_REPO = "linux-poky-debian.git"
LINUX_SRCREV = "linux-3.10.y-ltsi-rc1"
# LINUX_CONF is defined in recipes-kernel/linux*
```

## meta-minnow/conf/machine/minnow.conf
```bitbake
#@TYPE: Machine
#@NAME: atomboard
#@DESCRIPTION: Machine configuration for Minnowboard (Atom E640)

require conf/machine/include/tune-atom.inc

SERIAL_CONSOLE = "115200 ttyPCH0"
KERNEL_IMAGETYPE = "bzImage"
IMAGE_FSTYPES = "tar.gz"
```

## meta-minnowfast/conf/layer.conf
```bitbake
BBPATH := "${BBPATH}:${LAYERDIR}"
BBFILES := " ${BBFILES} \
${LAYERDIR}/recipes-*/*/*.bb \
${LAYERDIR}/recipes-*/*/*.bbappend \
"

BBFILE_COLLECTIONS += "minnowfast"
BBFILE_PATTERN_minnowfast := "^${LAYERDIR}/"
BBFILE_PRIORITY_minnowfast = "6"

RELEASE_VERSION = "${DEBIAN_SQUEEZE_VERSION}-minnowfast-0.1"

MACHINE = "minnowfast"

LINUX_REPO = "linux-poky-debian.git"
LINUX_SRCREV = "linux-3.10.y-ltsi-rc1"
# LINUX_CONF is defined in recipes-kernel/linux*
```

## meta-oss/conf/layer.conf
```bitbake
BBPATH := "${BBPATH}:${LAYERDIR}"
BBFILES := " ${BBFILES} \
${LAYERDIR}/recipes-*/*/*.bb \
${LAYERDIR}/recipes-*/*/*.bbappend \
"

BBFILE_COLLECTIONS += "oss"
BBFILE_PATTERN_oss := "^${LAYERDIR}/"
BBFILE_PRIORITY_oss = "5"
```

## meta-pandaboard/meta-minimal/conf/layer.conf
```bitbake
include conf/distro/include/gcc-linaro.inc

BBPATH := "${BBPATH}:${LAYERDIR}"
BBFILES := " ${BBFILES} \
${LAYERDIR}/recipes-*/*/*.bb \
${LAYERDIR}/recipes-*/*/*.bbappend \
"

BBFILE_COLLECTIONS += "pandaboard"
BBFILE_PATTERN_pandaboard := "^${LAYERDIR}/"
BBFILE_PRIORITY_pandaboard = "6"

RELEASE_VERSION = "${DEBIAN_SQUEEZE_VERSION}-pandaboard-rc1"

MACHINE = "pandaboard"

LINUX_REPO = "linux-poky-debian.git"
LINUX_SRCREV = "ltsi-3.10-rt"
# LINUX_CONF is defined in recipes-kernel/linux*
```

## meta-pandaboard/meta-minimal/conf/machine/pandaboard.conf
```bitbake
#@TYPE: Machine
#@NAME: pandaboard
#@DESCRIPTION: Machine setting for 'PandaBoard' (cortex-A9 board)

include conf/machine/include/tune-cortexa9.inc

KERNEL_IMAGETYPE = "zImage"

IMAGE_FSTYPES = "tar.gz"

SERIAL_CONSOLE = "115200 ttyO2"

EXTRA_IMAGEDEPENDS += "u-boot x-load"

UBOOT_MACHINE = "omap4_panda_config"
```

## meta-qemuarm/conf/bblayers.conf
```bitbake
LCONF_VERSION = "4"

BBFILES ?= ""
BBLAYERS = " \
##COREBASE##/meta \
##COREBASE##/meta-yocto \
##COREBASE##/meta-qemuarm \
"
```

## meta-qemuarm/conf/layer.conf
```bitbake
BBPATH := "${BBPATH}:${LAYERDIR}"
BBFILES := " ${BBFILES} \
${LAYERDIR}/recipes-*/*/*.bb \
${LAYERDIR}/recipes-*/*/*.bbappend \
"

BBFILE_COLLECTIONS += "qemuarm"
BBFILE_PATTERN_qemuarm := "^${LAYERDIR}/"
BBFILE_PRIORITY_qemuarm = "6"

# use gcc-linaro instead of the default gcc
include conf/distro/include/gcc-linaro.inc

MACHINE = "qemuarm"

# FIXME: LTSI boot failed on qemuarm
LINUX_SRCREV = "v3.0.38-debian-squeeze"
LINUX_CONF = "arch/arm/configs/qemu-versatilepb"
```

## meta-qemuppc/conf/layer.conf
```bitbake
BBPATH := "${BBPATH}:${LAYERDIR}"
BBFILES := " ${BBFILES} \
${LAYERDIR}/recipes-*/*/*.bb \
${LAYERDIR}/recipes-*/*/*.bbappend \
"

BBFILE_COLLECTIONS += "qemuppc"
BBFILE_PATTERN_qemuppc := "^${LAYERDIR}/"
BBFILE_PRIORITY_qemuppc = "6"

MACHINE = "qemuppc"

LINUX_CONF ?= "arch/powerpc/configs/qemu-g3beige"
```

## meta-qemuppc/conf/machine/qemuppc.conf
```bitbake
#@TYPE: Machine
#@NAME: qemu PPC Emulator setup
#@DESCRIPTION: Machine configuration for running an PPC system under qemu emulation

require conf/machine/include/qemu.inc
require conf/machine/include/tune-ppc750.inc

KERNEL_IMAGETYPE = "vmlinux"

# FIXME: prelink doesn't work
USER_CLASSES = "image-mklibs"

SERIAL_CONSOLE = "115200 ttyPZ0"
```

## meta-qemux86-64/conf/bblayers.conf
```bitbake
LCONF_VERSION = "4"

BBFILES ?= ""
BBLAYERS = " \
##COREBASE##/meta \
##COREBASE##/meta-yocto \
##COREBASE##/meta-qemux86-64 \
"
```

## meta-qemux86-64/conf/layer.conf
```bitbake
BBPATH := "${BBPATH}:${LAYERDIR}"
BBFILES := " ${BBFILES} \
${LAYERDIR}/recipes-*/*/*.bb \
${LAYERDIR}/recipes-*/*/*.bbappend \
"

BBFILE_COLLECTIONS += "qemux86-64"
BBFILE_PATTERN_qemux86-64 := "^${LAYERDIR}/"
BBFILE_PRIORITY_qemux86-64 = "6"

MACHINE = "qemux86-64"

LINUX_CONF ?= "arch/x86/configs/x86_64_defconfig"
```

## meta-qemux86-64/conf/machine/qemux86-64.conf
```bitbake
#@TYPE: Machine
#@NAME: qemux86-64
#@DESCRIPTION: Machine configuration for running a common x86-64

require conf/machine/include/tune-x86_64.inc
require conf/machine/include/qemu.inc

KERNEL_IMAGETYPE = "bzImage"

SERIAL_CONSOLE = "115200 ttyS0"
```

## meta-qemux86/conf/layer.conf
```bitbake
BBPATH := "${BBPATH}:${LAYERDIR}"
BBFILES := " ${BBFILES} \
${LAYERDIR}/recipes-*/*/*.bb \
${LAYERDIR}/recipes-*/*/*.bbappend \
"

BBFILE_COLLECTIONS += "qemux86"
BBFILE_PATTERN_qemux86 := "^${LAYERDIR}/"
BBFILE_PRIORITY_qemux86 = "6"

MACHINE = "qemux86"

LINUX_CONF ?= "arch/x86/configs/i386_defconfig"
```

## meta-qemux86/conf/machine/qemux86.conf
```bitbake
#@TYPE: Machine
#@NAME: qemux86
#@DESCRIPTION: Machine configuration for running a common x86

require conf/machine/include/tune-i586.inc
require conf/machine/include/qemu.inc

KERNEL_IMAGETYPE = "bzImage"
```

## meta-qemux86/meta-serial/conf/layer.conf
```bitbake
BBPATH := "${BBPATH}:${LAYERDIR}"
BBFILES := " ${BBFILES} \
${LAYERDIR}/recipes-*/*/*.bb \
${LAYERDIR}/recipes-*/*/*.bbappend \
"

BBFILE_COLLECTIONS += "qemux86-serial"
BBFILE_PATTERN_qemux86-serial := "^${LAYERDIR}/"
BBFILE_PRIORITY_qemux86-serial = "7"

SERIAL_CONSOLE = "115200 ttyS0"
```

## meta-zynq/conf/layer.conf
```bitbake
include conf/distro/include/gcc-linaro.inc

BBPATH := "${BBPATH}:${LAYERDIR}"
BBFILES := " ${BBFILES} \
${LAYERDIR}/recipes-*/*/*.bb \
${LAYERDIR}/recipes-*/*/*.bbappend \
"
BBFILE_COLLECTIONS += "zynq"
BBFILE_PATTERN_zynq = "^${LAYERDIR}/"
BBFILE_PRIORITY_zynq = "7"

LINUX_REPO = "linux-poky-debian.git"
LINUX_SRCREV = "linux-3.10.y-ltsi-rc1"
#LINUX_CONF = "arch/arm/configs/xilinx_zynq_defconfig"
```

## meta-zynq/conf/machine/include/machine-zc70x.inc
```bitbake
KERNEL_IMAGETYPE = "uImage"

# Set default load address.
# Override with KERNEL_EXTRA_ARGS_<board> += "..." in machine file if required
KERNEL_EXTRA_ARGS += "UIMAGE_LOADADDR=0x8000"
#UBOOT_ENTRYPOINT ?= "0x8000"

SERIAL_CONSOLE = "115200 ttyPS0"

#MACHINE_ESSENTIAL_EXTRA_RDEPENDS += "grub"

IMAGE_FSTYPES ?= "tar.gz"
```

## meta-zynq/conf/machine/zc702.conf
```bitbake
#@TYPE: Machine
#@NAME: zc702
#@DESCRIPTION: Machine support for ZC702 Evaluation Board.
#
# For details on the Evaluation board:
#     http://www.xilinx.com/products/boards-and-kits/EK-Z7-ZC702-G.htm
# For documentation and design files for the ZC702:
#     http://www.xilinx.com/support/index.html/content/xilinx/en/supportNav/boards_and_kits/zynq-7000_soc_boards_and_kits/zynq-7000_soc_zc702_evaluation_kit.html
# For the FSBL 'zynq_fsbl_0.elf' refer to UG873 and the associated design files.
#

#require conf/machine/include/tune-zynq.inc
require conf/machine/include/tune-cortexa9.inc
require conf/machine/include/machine-zc70x.inc

KERNEL_DTS = "${S}/arch/arm/boot/dts/zynq-zc702.dts"
KERNEL_DTB = "/boot/zynq-zc702.dtb"
```
