## meta-zynq/conf/machine/zc706.conf
```bitbake
#@TYPE: Machine
#@NAME: zc706
#@DESCRIPTION: Machine support for ZC706 Evaluation Board.

require conf/machine/include/tune-cortexa9.inc
require conf/machine/include/machine-zc70x.inc

KERNEL_DTS = "${S}/arch/arm/boot/dts/zynq-zc706.dts"
KERNEL_DTB = "/boot/zynq-zc706.dtb"
```

## meta-zynq/meta-zc702/conf/bblayers.conf
```bitbake
LCONF_VERSION = "4"

BBFILES ?= ""
BBLAYERS = " \
##COREBASE##/meta \
##COREBASE##/meta-yocto \
##COREBASE##/meta-zynq \
##COREBASE##/meta-zynq/meta-zc702 \
"
```

## meta-zynq/meta-zc702/conf/layer.conf
```bitbake
BBPATH := "${BBPATH}:${LAYERDIR}"
BBFILES := " ${BBFILES} \
${LAYERDIR}/recipes-*/*/*.bb \
${LAYERDIR}/recipes-*/*/*.bbappend \
"

BBFILE_COLLECTIONS += "zc702"
BBFILE_PATTERN_zc702 := "^${LAYERDIR}/"
BBFILE_PRIORITY_zc702 = "8"

RELEASE_VERSION = "${DEBIAN_SQUEEZE_VERSION}-${MACHINE}-alpha1"

MACHINE = "zc702"

LINUX_CONF = "arch/arm/configs/xilinx_zynq702_defconfig"
```

## meta/conf/distro/debian-squeeze.conf
```bitbake
#
# Debian specific information
#

# version
DEBIAN_SQUEEZE_CODENAME ?= "squeeze"
DEBIAN_SQUEEZE_VERSION ?= "1.0.2"

# Please note.
# All valiables for Git servers are sencitive for slash at the end of value
#
# git servers
#
DEBIAN_SQUEEZE_GIT_KERNEL ?= "git://github.com/ystk/"
DEBIAN_SQUEEZE_GIT_BOOTLOADER ?= "git://github.com/ystk/bootloaders-"
DEBIAN_SQUEEZE_GIT_APP ?= "git://github.com/ystk/debian-"
DEBIAN_SQUEEZE_GIT_TOOLS ?= "git://github.com/ystk/tools-"
DEBIAN_SQUEEZE_GIT_OSS ?= "git://github.com/ystk/oss-"
DEBIAN_SQUEEZE_GIT_YOCTO ?= "${DEBIAN_SQUEEZE_GIT_TOOLS}yocto1-"

# default providers
INIT_PROVIDER ?= "busybox"
GETTY_PROVIDER ?= "busybox"
LOGIN_PROVIDER ?= "busybox"
SHELL_PROVIDER ?= "busybox"
MOUNT_PROVIDER ?= "busybox"
NET_PROVIDER ?= "busybox"

# default features
DEBIAN_SQUEEZE_FEATURES ?= " \
devshm \
devpts \
net \
update-rc.d \
release-info \
"

# default kernel providers
PREFERRED_PROVIDER_virtual/kernel ?= "linux"
PREFERRED_PROVIDER_linux-libc-headers ?= "linux-libc-headers"
PREFERRED_PROVIDER_linux-libc-headers-nativesdk ?= "linux-libc-headers-nativesdk"

#
# poky internal settings (based on poky.conf)
#

DISTRO = "debian-squeeze"
DISTRO_NAME = "Debian"
DISTRO_VERSION = "1.0"
SDK_VENDOR = "-debiansdk"
SDK_VERSION := "${@'${DISTRO_VERSION}'.replace('snapshot-${DATE}','snapshot')}"

MAINTAINER = "YOSHI <yoshitake.kobayashi@toshiba.co.jp>"

TARGET_VENDOR = "-debian"

LOCALCONF_VERSION = "1"

SDK_NAME = "${DISTRO}-${TCLIBC}-${SDK_ARCH}-${TARGET_ARCH}"

# SDK install path
# if RELEASE_VERSION is defined     => /opt/sdk-${RELEASE_VERSION}
# if RELEASE_VERSION is not defined => /opt/sdk-${DEBIAN_SQUEEZE_VERSION}-${MACHINE}
SDK_RELEASE_DEFAULT ?= "${DEBIAN_SQUEEZE_VERSION}-${MACHINE}"
SDK_RELEASE ?= "${@[bb.data.getVar('RELEASE_VERSION', d), bb.data.getVar('SDK_RELEASE_DEFAULT', d)][bb.data.getVar('RELEASE_VERSION', d) == None]}"
SDKPATH = "/opt/sdk-${SDK_RELEASE}"

TCLIBCAPPEND = ""

QEMU_TARGETS ?= "arm i386 mips mipsel ppc x86_64"
# Other QEMU_TARGETS "mips64 mips64el sh4"

# there is no mirror for poky-debian
PREMIRRORS = ""
#PREMIRRORS_URI = "${POKY_DEBIAN_SQUEEZE}"
#PREMIRRORS ?= " \
#bzr://.*/.* ${PREMIRRORS_URI} \n \
#cvs://.*/.* ${PREMIRRORS_URI} \n \
#git://.*/.* ${PREMIRRORS_URI} \n \
#hg://.*/.*  ${PREMIRRORS_URI} \n \
#osc://.*/.* ${PREMIRRORS_URI} \n \
#p4://.*/.*  ${PREMIRRORS_URI} \n \
#svk://.*/.* ${PREMIRRORS_URI} \n \
#svn://.*/.* ${PREMIRRORS_URI} \n \
#"

# there is no mirror for poky-debian
MIRRORS = ""
#MIRRORS_URI = "${POKY_DEBIAN_SQUEEZE}"
#MIRRORS =+ " \
#ftp://.*/.*   ${MIRRORS_URI} \n \
#http://.*/.*  ${MIRRORS_URI} \n \
#https://.*/.* ${MIRRORS_URI} \n \
#"

# The CONNECTIVITY_CHECK_URI's are used to test whether we can succesfully
# fetch from the network (and warn you if not). To disable the test set
# the variable to be empty.
CONNECTIVITY_CHECK_URIS ?= ""
```

## meta/conf/distro/include/gcc-linaro.inc
```bitbake
#
# parameters to use gcc-linaro
#

GCCVERSION = "4.7"
SDKGCCVERSION = "4.7"

PREFERRED_PROVIDER_virtual/${TARGET_PREFIX}gcc-initial = "gcc-linaro-cross-initial"
PREFERRED_PROVIDER_virtual/${TARGET_PREFIX}gcc-intermediate = "gcc-linaro-cross-intermediate"
PREFERRED_PROVIDER_virtual/${TARGET_PREFIX}gcc = "gcc-linaro-cross"
PREFERRED_PROVIDER_virtual/${TARGET_PREFIX}g++ = "gcc-linaro-cross"
PREFERRED_PROVIDER_virtual/${TARGET_PREFIX}compilerlibs = "gcc-linaro-runtime"
PREFERRED_PROVIDER_libgcc = "libgcc-linaro"

PREFERRED_PROVIDER_virtual/${SDK_PREFIX}gcc-initial-crosssdk = "gcc-linaro-crosssdk-initial"
PREFERRED_PROVIDER_virtual/${SDK_PREFIX}gcc-intermediate-crosssdk = "gcc-linaro-crosssdk-intermediate"
PREFERRED_PROVIDER_virtual/${SDK_PREFIX}gcc-crosssdk = "gcc-linaro-crosssdk"
PREFERRED_PROVIDER_virtual/${SDK_PREFIX}g++-crosssdk = "gcc-linaro-crosssdk"
PREFERRED_PROVIDER_virtual/${SDK_PREFIX}compilerlibs-nativesdk = "gcc-linaro-runtime-nativesdk"
PREFERRED_PROVIDER_libgcc-nativesdk = "libgcc-linaro-nativesdk"

PREFERRED_PROVIDER_virtual/gcc-cross-canadian = "gcc-linaro-cross-canadian"
```

## meta/conf/machine/include/tune-ppc750.inc
```bitbake
TARGET_CC_ARCH = "-mcpu=750"
BASE_PACKAGE_ARCH = "ppc750"
FEED_ARCH = "ppc750"
PACKAGE_EXTRA_ARCHS += "ppc750"

DEFAULTTUNE ?= "ppc750"

require conf/machine/include/powerpc/arch-powerpc.inc

TUNEVALID[ppc750] = "Enable ppc750 specific processor optimizations"
TUNE_CCARGS += "${@bb.utils.contains("TUNE_FEATURES", "ppc750", "-mcpu=750", "", d)}"
TUNE_PKGARCH = "${@bb.utils.contains('TUNE_FEATURES', 'ppc750', 'ppc750', '${PPCPKGARCH}', d)}"

AVAILTUNES = "ppc750"
TUNE_FEATURES_tune-ppc750 = "m32 fpu-hard ppc750"
PACKAGE_EXTRA_ARCHS_tune-ppc750 = "powerpc ppc750"
```

## meta/conf/machine/include/tune-thumb.inc
```bitbake
#tune file for thumb instructions

ARM_INSTRUCTION_SET ?= "arm"
# "arm" "thumb"
#    The instruction set the compiler should use when generating application
#    code.  The kernel is always compiled with arm code at present.  arm code
#    is the original 32 bit ARM instruction set, thumb code is the 16 bit
#    encoded RISC sub-set.  Thumb code is smaller (maybe 70% of the ARM size)
#    but requires more instructions (140% for 70% smaller code) so may be
#    slower.

THUMB_INTERWORK ?= "yes"
# "yes" "no"
#    Whether to compile with code to allow interworking between the two
#    instruction sets.  This allows thumb code to be executed on a primarily
#    arm system and vice versa.  It is strongly recommended that DISTROs not
#    turn this off - the actual cost is very small.

OVERRIDE_THUMB = "${@['', ':thumb'][bb.data.getVar('ARM_INSTRUCTION_SET', d, 1) == 'thumb']}"
OVERRIDE_INTERWORK = "${@['', ':thumb-interwork'][bb.data.getVar('THUMB_INTERWORK', d, 1) == 'yes']}"
OVERRIDES .= "${OVERRIDE_THUMB}${OVERRIDE_INTERWORK}"

#    Set thumb option parameter for gcc
#    If gcc version is more than 4.7, set "-marm"
#    and if gcc version is other, set "-mno-thumb"
ARM_THUMB_M_OPT_TMP = "${@['-mno-thumb', '-marm'][bb.utils.vercmp(('', bb.data.getVar('GCCVERSION', d), ''), ('', '4.7', '')) >= 0]}"

#    Compiler and linker options for application code and kernel code.  These
#    options ensure that the compiler has the correct settings for the selected
#    instruction set and interworking.
ARM_INTERWORK_M_OPT = "${@['-mno-thumb-interwork', '-mthumb-interwork'][bb.data.getVar('THUMB_INTERWORK', d, 1) == 'yes']}"
ARM_THUMB_M_OPT = "${@['${ARM_THUMB_M_OPT_TMP}', '-mthumb'][bb.data.getVar('ARM_INSTRUCTION_SET', d, 1) == 'thumb']}"

#
TUNE_CCARGS +=  "${ARM_INTERWORK_M_OPT} ${ARM_THUMB_M_OPT}"
TARGET_CC_KERNEL_ARCH  += "-mno-thumb-interwork ${ARM_THUMB_M_OPT_TMP}"
```
